/* FICHIER GENERE par configurationLDO/generer_config.py depuis ldo_config.csv.
 * NE PAS MODIFIER : modifier le CSV (ou la page /dac/config) puis recompiler.
 * Inclus dans l'initialiseur de ldoConfig[] (main.c). Empreinte 0x30A4CC7D. */
    /* LDO 1 : I2C1 0xC0 */
    { "1PSp", GPIOF, GPIO_PIN_0, GPIOF, GPIO_PIN_8, GPIOF, GPIO_PIN_9, GPIOD, GPIO_PIN_1, &ldoEtat[0], CIBLE_DAC1, 3, CIBLE_DAC1, 1, OC_LM211(0U), BLD_HAUT, 1U, 1U, MUX_NC, MUX_NC, SEUIL_SOURCE, MEM_RAM, 0U, 0U },
    /* LDO 2 : I2C1 0xC0, OC en EXTI (PE4) */
    { "2PSp", GPIOE, GPIO_PIN_5, GPIOF, GPIO_PIN_1, GPIOE, GPIO_PIN_4, GPIOF, GPIO_PIN_2, &ldoEtat[1], CIBLE_DAC1, 4, CIBLE_DAC1, 5, OC_LM211(1U), BLD_HAUT, 1U, 1U, MUX_NC, MUX_NC, SEUIL_SOURCE, MEM_EEPROM, 0U, 0U },
    /* LDO 3 : I2C2 (heritage) */
    { "3PSp", GPIOE, GPIO_PIN_2, GPIOD, GPIO_PIN_7, GPIOD, GPIO_PIN_6, GPIOE, GPIO_PIN_3, &ldoEtat[2], CIBLE_DAC2, 0, CIBLE_DAC2, 2, OC_LM211(0U), BLD_HAUT, 1U, 1U, MUX_NC, MUX_NC, SEUIL_SOURCE, MEM_RAM, 0U, 0U },
    /* LDO 4 : conflit 1PSp */
    { "4PSp", GPIOA, GPIO_PIN_0, GPIOC, GPIO_PIN_15, GPIOB, GPIO_PIN_0, GPIOA, GPIO_PIN_4, &ldoEtat[3], CIBLE_AUCUNE, 0, CIBLE_AUCUNE, 0, OC_SANS, BLD_HAUT, 1U, 1U, MUX_NC, MUX_NC, SEUIL_SOURCE, MEM_RAM, 0U, 0U },
    /* LDO 5 : conflit 2PSp */
    { "5PSp", GPIOF, GPIO_PIN_7, GPIOC, GPIO_PIN_13, GPIOF, GPIO_PIN_6, GPIOC, GPIO_PIN_14, &ldoEtat[4], CIBLE_AUCUNE, 0, CIBLE_AUCUNE, 0, OC_SANS, BLD_HAUT, 1U, 1U, MUX_NC, MUX_NC, SEUIL_SOURCE, MEM_RAM, 0U, 0U },
    /* LDO 6 : non cable */
    { "6PSp", GPIOC, GPIO_PIN_10, GPIOD, GPIO_PIN_2, GPIOC, GPIO_PIN_11, GPIOC, GPIO_PIN_12, &ldoEtat[5], CIBLE_AUCUNE, 0, CIBLE_AUCUNE, 0, OC_SANS, BLD_HAUT, 1U, 1U, MUX_NC, MUX_NC, SEUIL_SOURCE, MEM_RAM, 0U, 0U },
    /* LDO 7 : ex-1PSn (non cable) */
    { "7PSp", GPIOC, GPIO_PIN_8, GPIOC, GPIO_PIN_9, GPIOC, GPIO_PIN_6, GPIOD, GPIO_PIN_8, &ldoEtat[6], CIBLE_AUCUNE, 0, CIBLE_AUCUNE, 0, OC_SANS, BLD_HAUT, 1U, 1U, MUX_NC, MUX_NC, SEUIL_SOURCE, MEM_RAM, 0U, 0U },
    /* LDO 8 : ex-2PSn (non cable) */
    { "8PSp", GPIOA, GPIO_PIN_6, GPIOA, GPIO_PIN_5, GPIOA, GPIO_PIN_11, GPIOB, GPIO_PIN_12, &ldoEtat[7], CIBLE_AUCUNE, 0, CIBLE_AUCUNE, 0, OC_SANS, BLD_HAUT, 1U, 1U, MUX_NC, MUX_NC, SEUIL_SOURCE, MEM_RAM, 0U, 0U },
    /* LDO 9 : ex-3PSn (conflit 1PLp) */
    { "9PSp", GPIOB, GPIO_PIN_4, GPIOB, GPIO_PIN_1, GPIOB, GPIO_PIN_3, GPIOF, GPIO_PIN_5, &ldoEtat[8], CIBLE_AUCUNE, 0, CIBLE_AUCUNE, 0, OC_SANS, BLD_HAUT, 1U, 1U, MUX_NC, MUX_NC, SEUIL_SOURCE, MEM_RAM, 0U, 0U },
    /* LDO 10 : ex-4PSn (I2C2 (heritage)) */
    { "10PSp", GPIOD, GPIO_PIN_15, GPIOD, GPIO_PIN_14, GPIOF, GPIO_PIN_14, GPIOE, GPIO_PIN_9, &ldoEtat[9], CIBLE_DAC5, 4, CIBLE_DAC5, 6, OC_LM211(0U), BLD_HAUT, 1U, 1U, MUX_NC, MUX_NC, SEUIL_SOURCE, MEM_RAM, 0U, 0U },
    /* LDO 11 : ex-5PSn (I2C2 (heritage)) */
    { "11PSp", GPIOF, GPIO_PIN_3, GPIOE, GPIO_PIN_11, GPIOF, GPIO_PIN_15, GPIOF, GPIO_PIN_11, &ldoEtat[10], CIBLE_DAC5, 0, CIBLE_DAC5, 2, OC_LM211(0U), BLD_HAUT, 1U, 1U, MUX_NC, MUX_NC, SEUIL_SOURCE, MEM_RAM, 0U, 0U },
    /* LDO 12 : ex-6PSn (I2C2 (heritage)) */
    { "12PSp", GPIOG, GPIO_PIN_8, GPIOE, GPIO_PIN_0, GPIOG, GPIO_PIN_5, GPIOG, GPIO_PIN_6, &ldoEtat[11], CIBLE_DAC5, 1, CIBLE_DAC5, 3, OC_LM211(0U), BLD_HAUT, 1U, 1U, MUX_NC, MUX_NC, SEUIL_SOURCE, MEM_RAM, 0U, 0U },
    /* LDO 13 : ex-1PLp (I2C1 0xC2, pas de courant) */
    { "13PSp", GPIOE, GPIO_PIN_1, GPIOG, GPIO_PIN_12, GPIOG, GPIO_PIN_10, GPIOD, GPIO_PIN_0, &ldoEtat[12], CIBLE_DAC3, 0, CIBLE_AUCUNE, 0, OC_SANS, BLD_HAUT, 1U, 1U, MUX_NC, MUX_NC, SEUIL_SOURCE, MEM_RAM, 0U, 0U },
    /* LDO 14 : ex-2PLp (pas de courant) */
    { "14PSp", GPIOA, GPIO_PIN_3, GPIOD, GPIO_PIN_12, GPIOE, GPIO_PIN_10, GPIOG, GPIO_PIN_1, &ldoEtat[13], CIBLE_DAC4, 2, CIBLE_AUCUNE, 0, OC_SANS, BLD_HAUT, 1U, 1U, MUX_NC, MUX_NC, SEUIL_SOURCE, MEM_RAM, 0U, 0U },
    /* LDO 15 : ex-3PLp (pas de courant) */
    { "15PSp", GPIOF, GPIO_PIN_13, GPIOF, GPIO_PIN_12, GPIOG, GPIO_PIN_4, GPIOE, GPIO_PIN_15, &ldoEtat[14], CIBLE_DAC5, 5, CIBLE_AUCUNE, 0, OC_SANS, BLD_HAUT, 1U, 1U, MUX_NC, MUX_NC, SEUIL_SOURCE, MEM_RAM, 0U, 0U },
    /* LDO 16 : ex-1PLn (I2C2 (heritage)) */
    { "16PSp", GPIOG, GPIO_PIN_0, GPIOE, GPIO_PIN_6, GPIOD, GPIO_PIN_9, GPIOG, GPIO_PIN_9, &ldoEtat[15], CIBLE_DAC4, 3, CIBLE_DAC4, 5, OC_LM211(0U), BLD_HAUT, 1U, 1U, MUX_NC, MUX_NC, SEUIL_SOURCE, MEM_RAM, 0U, 0U },
    /* LDO 17 (de cote) : I2C2 (heritage) */
    { "2PLn", GPIOA, GPIO_PIN_10, GPIOE, GPIO_PIN_12, GPIOD, GPIO_PIN_11, GPIOD, GPIO_PIN_13, &ldoEtat[16], CIBLE_DAC4, 7, CIBLE_DAC4, 6, OC_LM211(0U), BLD_HAUT, 1U, 1U, MUX_NC, MUX_NC, SEUIL_SOURCE, MEM_RAM, 0U, 0U },
    /* LDO 18 (de cote) : I2C2 (heritage) */
    { "3PLn", GPIOE, GPIO_PIN_13, GPIOD, GPIO_PIN_10, GPIOG, GPIO_PIN_7, GPIOE, GPIO_PIN_14, &ldoEtat[17], CIBLE_DAC4, 4, CIBLE_DAC5, 7, OC_LM211(0U), BLD_HAUT, 1U, 1U, MUX_NC, MUX_NC, SEUIL_SOURCE, MEM_RAM, 0U, 0U },
